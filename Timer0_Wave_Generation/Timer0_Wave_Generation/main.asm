;
; Timer0_Wave_Generation.asm
;
; Created: 10/18/2023 10:51:49 AM
; Author : Options
;


; Replace with your application code

.INCLUDE "m32def.inc"

.ORG 0x00
JMP MAIN

.ORG 0x14
JMP TIMER0_COMP

.ORG 0x100
MAIN:
LDI R16,HIGH(RAMEND)
OUT SPH,R16
LDI R16,LOW(RAMEND)
OUT SPL,R16

LDI R20,0x01

SBI DDRB,PB3

LDI R16,0x00
OUT TCNT0,R16
LDI R16,0x45
OUT OCR0,R16
LDI R16,0x19
OUT TCCR0,R16
LDI R16,0x02
OUT TIMSK,R16
SEI
LOOP: RJMP LOOP

.ORG 0x200
TIMER0_COMP:
DEC R20
BRNE HERE
LDI ZL,LOW(WAVE_TABLE << 1)
LDI ZH,HIGH(WAVE_TABLE << 1)
LDI R20,0x02
HERE:
LPM R16,Z+
OUT OCR0,R16
RETI


WAVE_TABLE:
.DB 0x63, 0x45