;
; Timer1_Input_Capture.asm
;
; Created: 10/28/2023 10:30:10 AM
; Author : Options
;


; Replace with your application code

.INCLUDE "m32def.inc"

.ORG 0x00
MAIN:
LDI R16,HIGH(RAMEND)
OUT SPH,R16
LDI R16,LOW(RAMEND)
OUT SPL,R16

CBI DDRD,PD6
LDI R16,0xFF
OUT DDRA,R16
OUT DDRC,R16

LDI R16,0x00
OUT TCNT1H,R16
OUT TCNT1L,R16

OUT TCCR1A,R16
LDI R16,0x42
OUT TCCR1B,R16

CALL WAIT_FOR_EDGE
IN R1,ICR1L
IN R2,ICR1H

LDI R16,0x02
OUT TCCR1B,R16

CALL WAIT_FOR_EDGE
IN R3,ICR1L
IN R4,ICR1H

SUB R3,R1
SBC R4,R2

OUT PORTA,R3
OUT PORTC,R4

LOOP: RJMP LOOP

.ORG 0x100
WAIT_FOR_EDGE:
IN R16,TIFR
SBRS R16,ICF1
RJMP WAIT_FOR_EDGE
LDI R16,1<<ICF1
OUT TIFR,R16
RET


