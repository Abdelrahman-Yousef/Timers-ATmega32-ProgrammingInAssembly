;
; Timer0_FastPWM.asm
;
; Created: 11/12/2023 10:10:57 AM
; Author : Options
;


; Replace with your application code
.INCLUDE "m32def.inc"

.ORG 0x00
JMP MAIN

.ORG 0x16
JMP TIMER0_OVF

.ORG 0x100
MAIN:
LDI R16,HIGH(RAMEND)
OUT SPH,R16
LDI R16,LOW(RAMEND)
OUT SPL,R16

SBI DDRB,PB3

LDI R16,0x00
OUT TCNT0,R16
LDI R20,0x63
OUT OCR0,R20
LDI R16,0x69
OUT TCCR0,R16
LDI R16,0x01
;OUT TIMSK,R16
;SEI

NEG R20
OUT OCR0,R20

LOOP:
IN R16,TIFR
SBRS R16,TOV0
RJMP LOOP
LDI R16,0x01
OUT TIFR,R16
NEG R20
OUT OCR0,R20
RJMP LOOP


.ORG 0x200
TIMER0_OVF:
NEG R20
OUT OCR0,R20
RETI




















;.INCLUDE "m32def.inc"

;.ORG 0x00
;MAIN:
;LDI R16,0x00
;OUT TCNT0,R16
;LDI R16,0x9F
;OUT OCR0,R16
;LDI R16,0x7A
;OUT TCCR0,R16
;SBI DDRB,PB3
;LOOP: RJMP LOOP
